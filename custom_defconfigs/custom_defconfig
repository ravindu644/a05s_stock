## custom_defconfigs/custom_defconfig
```kconfig
#General
CONFIG_LOCALVERSION="@ravindu644"
CONFIG_LOCALVERSION_AUTO=n

#kallsyms
CONFIG_DEBUG_KERNEL=y
CONFIG_KALLSYMS=y
CONFIG_KALLSYMS_ALL=y

#KernelSU
CONFIG_KSU=n

#Defex
CONFIG_SECURITY_DEFEX=n

#Loadable Kernel Module support
CONFIG_MODULES=y
CONFIG_MODULE_FORCE_LOAD=y
CONFIG_MODULE_UNLOAD=y
CONFIG_MODULE_FORCE_UNLOAD=y
CONFIG_MODVERSIONS=y
CONFIG_MODULE_SRCVERSION_ALL=n
CONFIG_MODULE_SIG=n
CONFIG_MODULE_COMPRESS=n
CONFIG_TRIM_UNUSED_KSYMS=n

#Always permissive
CONFIG_SECURITY_SELINUX_ALWAYS_PERMISSIVE=y

# Disabled dm verity
CONFIG_DM_INIT=n
CONFIG_DM_VERITY=n
CONFIG_DM_BOW=n
CONFIG_DM_USER=n
```
